/**
 * @cliArgs --board "/ti/boards/LP_MSPM0G3507" --package "LQFP-64(PM)" --part "Default" --product "mspm0_sdk@2.01.00.03"
 * @versions {"tool":"1.20.0+3587"}
 */

/**
 * Import the modules used in this configuration.
 */
const GPIO    = scripting.addModule("/ti/driverlib/GPIO", {}, false);
const GPIO1   = GPIO.addInstance();  // OLED_RST  PB14
const GPIO2   = GPIO.addInstance();  // OLED_DC   PB15
const GPIO3   = GPIO.addInstance();  // OLED_SCL  PA28
const GPIO4   = GPIO.addInstance();  // OLED_SDA  PA31
const GPIO5   = GPIO.addInstance();  // LED       PB9
const GPIO6   = GPIO.addInstance();  // MPU6050   PA7
const GPIO7   = GPIO.addInstance();  // AIN dir   PA14,PA13
const GPIO8   = GPIO.addInstance();  // BIN dir   PA16,PA17
const GPIO9   = GPIO.addInstance();  // ENCODERA  PA25,PA26
const GPIO10  = GPIO.addInstance();  // ENCODERB  PB20,PB24
const GPIO11  = GPIO.addInstance();  // KEY       PA18
const I2C     = scripting.addModule("/ti/driverlib/I2C", {}, false);
const I2C1    = I2C.addInstance();
const PWM     = scripting.addModule("/ti/driverlib/PWM", {}, false);
const PWM1    = PWM.addInstance();
const SYSCTL  = scripting.addModule("/ti/driverlib/SYSCTL");
const SYSTICK = scripting.addModule("/ti/driverlib/SYSTICK");
const TIMER   = scripting.addModule("/ti/driverlib/TIMER", {}, false);
const TIMER1  = TIMER.addInstance();
const UART    = scripting.addModule("/ti/driverlib/UART", {}, false);
const UART1   = UART.addInstance();

/**
 * Write custom configuration values to the imported modules.
 */
// PLL配置: 32MHz SYSOSC -> PLL(x5) -> /2 -> /2 = 40MHz, CLK2X = 80MHz
const divider7       = system.clockTree["PLL_PDIV"];
divider7.divideValue = 2;

const divider9       = system.clockTree["UDIV"];
divider9.divideValue = 2;

const gate7  = system.clockTree["MFCLKGATE"];
gate7.enable = true;

const multiplier2         = system.clockTree["PLL_QDIV"];
multiplier2.multiplyValue = 5;

const mux8       = system.clockTree["HSCLKMUX"];
mux8.inputSelect = "HSCLKMUX_SYSPLL2X";

// ---- OLED引脚 ----
GPIO1.$name                         = "OLED_RST";
GPIO1.associatedPins[0].$name       = "PIN_RST";
GPIO1.associatedPins[0].pin.$assign = "PB14";

GPIO2.$name                         = "OLED_DC";
GPIO2.associatedPins[0].$name       = "PIN_DC";
GPIO2.associatedPins[0].pin.$assign = "PB15";

GPIO3.$name                         = "OLED_SCL";
GPIO3.associatedPins[0].$name       = "PIN_SCL";
GPIO3.associatedPins[0].pin.$assign = "PA28";

GPIO4.$name                         = "OLED_SDA";
GPIO4.associatedPins[0].$name       = "PIN_SDA";
GPIO4.associatedPins[0].pin.$assign = "PA31";

GPIO5.$name                         = "LED";
GPIO5.associatedPins[0].$name       = "led";
GPIO5.associatedPins[0].pin.$assign = "PB9";

// ---- MPU6050 中断 ----
GPIO6.$name                              = "MPU6050";
GPIO6.associatedPins[0].$name            = "INT_PIN";
GPIO6.associatedPins[0].direction        = "INPUT";
GPIO6.associatedPins[0].internalResistor = "PULL_UP";
GPIO6.associatedPins[0].pin.$assign      = "PA7";
GPIO6.associatedPins[0].interruptEn      = true;
GPIO6.associatedPins[0].polarity         = "FALL";

// ---- TB6612 A通道方向 ----
GPIO7.port                          = "PORTA";
GPIO7.$name                         = "AIN";
GPIO7.associatedPins.create(2);
GPIO7.associatedPins[0].$name       = "AIN1";
GPIO7.associatedPins[0].pin.$assign = "PA14";
GPIO7.associatedPins[1].$name       = "AIN2";
GPIO7.associatedPins[1].pin.$assign = "PA13";

// ---- TB6612 B通道方向 ----
GPIO8.port                          = "PORTA";
GPIO8.$name                         = "BIN";
GPIO8.associatedPins.create(2);
GPIO8.associatedPins[0].$name       = "BIN1";
GPIO8.associatedPins[0].pin.$assign = "PA16";
GPIO8.associatedPins[1].$name       = "BIN2";
GPIO8.associatedPins[1].pin.$assign = "PA17";

// ---- 编码器A (MG513) ----
GPIO9.$name                               = "ENCODERA";
GPIO9.associatedPins.create(2);
GPIO9.associatedPins[0].$name             = "E1A";
GPIO9.associatedPins[0].direction         = "INPUT";
GPIO9.associatedPins[0].polarity          = "RISE";
GPIO9.associatedPins[0].interruptEn       = true;
GPIO9.associatedPins[0].pin.$assign       = "PA25";
GPIO9.associatedPins[1].$name             = "E1B";
GPIO9.associatedPins[1].direction         = "INPUT";
GPIO9.associatedPins[1].polarity          = "RISE";
GPIO9.associatedPins[1].interruptEn       = true;
GPIO9.associatedPins[1].pin.$assign       = "PA26";

// ---- 编码器B (MG513) ----
GPIO10.$name                               = "ENCODERB";
GPIO10.associatedPins.create(2);
GPIO10.associatedPins[0].$name             = "E2A";
GPIO10.associatedPins[0].direction         = "INPUT";
GPIO10.associatedPins[0].polarity          = "RISE";
GPIO10.associatedPins[0].interruptEn       = true;
GPIO10.associatedPins[0].pin.$assign       = "PB20";
GPIO10.associatedPins[1].$name             = "E2B";
GPIO10.associatedPins[1].direction         = "INPUT";
GPIO10.associatedPins[1].polarity          = "RISE";
GPIO10.associatedPins[1].interruptEn       = true;
GPIO10.associatedPins[1].pin.$assign       = "PB24";

// ---- 按键 ----
GPIO11.$name                         = "KEY";
GPIO11.associatedPins[0].$name       = "key";
GPIO11.associatedPins[0].direction   = "INPUT";
GPIO11.associatedPins[0].pin.$assign = "PA18";

// ---- 硬件I2C0: MPU6050 ----
I2C1.$name                           = "I2C_0";
I2C1.basicEnableController           = true;
I2C1.basicControllerStandardBusSpeed = "Fast";
I2C1.sdaPinConfig.$name              = "ti_driverlib_gpio_GPIOPinGeneric2";
I2C1.sclPinConfig.$name              = "ti_driverlib_gpio_GPIOPinGeneric3";

// ---- PWM: TIMA1, PB2/PB3, 10kHz ----
PWM1.$name                      = "PWM_0";
PWM1.timerStartTimer            = true;
PWM1.pwmMode                    = "EDGE_ALIGN_UP";
PWM1.timerCount                 = 8000;
PWM1.peripheral.$assign         = "TIMA1";
PWM1.peripheral.ccp0Pin.$assign = "PB2";
PWM1.peripheral.ccp1Pin.$assign = "PB3";
PWM1.PWM_CHANNEL_0.$name        = "ti_driverlib_pwm_PWMTimerCC0";
PWM1.PWM_CHANNEL_1.$name        = "ti_driverlib_pwm_PWMTimerCC1";
PWM1.ccp0PinConfig.$name        = "ti_driverlib_gpio_GPIOPinGeneric4";
PWM1.ccp1PinConfig.$name        = "ti_driverlib_gpio_GPIOPinGeneric5";

// ---- 10ms 定时器 ----
TIMER1.$name              = "TIMER_0";
TIMER1.timerClkPrescale   = 32;
TIMER1.timerMode          = "PERIODIC";
TIMER1.timerStartTimer    = true;
TIMER1.interrupts         = ["ZERO"];
TIMER1.timerPeriod        = "10 ms";
TIMER1.peripheral.$assign = "TIMG0";

const Board = scripting.addModule("/ti/driverlib/Board", {}, false);

SYSCTL.forceDefaultClkConfig = true;
SYSCTL.clockTreeEn           = true;

SYSTICK.periodEnable  = true;
SYSTICK.systickEnable = true;
SYSTICK.period        = 16777216;

UART1.$name                    = "UART_0";
UART1.profile                  = "CONFIG_PROFILE_1";
UART1.peripheral.rxPin.$assign = "PA11";
UART1.peripheral.txPin.$assign = "PA10";
UART1.txPinConfig.$name        = "ti_driverlib_gpio_GPIOPinGeneric0";
UART1.rxPinConfig.$name        = "ti_driverlib_gpio_GPIOPinGeneric1";

/**
 * Pinmux solution.
 */
GPIO5.associatedPins[0].pin.$suggestSolution = "PB9";
Board.peripheral.$suggestSolution            = "DEBUGSS";
Board.peripheral.swclkPin.$suggestSolution   = "PA20";
Board.peripheral.swdioPin.$suggestSolution   = "PA19";
I2C1.peripheral.$suggestSolution             = "I2C0";
I2C1.peripheral.sdaPin.$suggestSolution      = "PA0";
I2C1.peripheral.sclPin.$suggestSolution      = "PA1";
UART1.peripheral.$suggestSolution            = "UART0";
